#define VERT_COMBO(NAME, KEYPOS) \
    combo_##NAME { \
        timeout-ms = <100>; \
        key-positions = <KEYPOS>; \
        bindings = <&kp NAME>; \
    };

#define HOR_COMBO(NAME, KEY, KEYPOS) \
    combo_##NAME { \
        timeout-ms = <30>; \
        key-positions = <KEYPOS>; \
        bindings = <&kp KEY>; \
    };

/*                KEY POSITIONS

     0   1   2   3   4      5   6   7   8   9
    10  11  12  13  14     15  16  17  18  19
    20  21  22  23  24     25  26  27  28  29
            30  31  32     33  34  35
*/      

/ {
    combos {
        compatible = "zmk,combos";
        
        // top row vertical combos
        VERT_COMBO(NUM_1, 0 10)
        VERT_COMBO(NUM_2, 1 11)
        VERT_COMBO(NUM_3, 2 12)
        VERT_COMBO(NUM_4, 3 13)
        VERT_COMBO(NUM_5, 4 14)
        VERT_COMBO(NUM_6, 5 15)
        VERT_COMBO(NUM_7, 6 16)
        VERT_COMBO(NUM_8, 7 17)
        VERT_COMBO(NUM_9, 8 18)
        VERT_COMBO(NUM_0, 9 19)

        // bottom row vertical combos
        VERT_COMBO(ESC, 10 20)
        VERT_COMBO(GRAVE, 11 21)
        VERT_COMBO(MINUS, 12 22)
        VERT_COMBO(EQUAL, 13 23)
        VERT_COMBO(LEFT_BRACKET, 16 26)
        VERT_COMBO(RIGHT_BRACKET, 17 27)
        VERT_COMBO(BACKSLASH, 18 28)
        VERT_COMBO(SCLN, 19 29)

        // left hand horizontal combos
        HOR_COMBO(TABL, TAB, 2 3)
        HOR_COMBO(BSPCL, BSPC, 12 13)
        HOR_COMBO(ENTERL, ENTER, 22 23)
        HOR_COMBO(DELL, DEL, 11 12)

        // right hand horizontal combos
        HOR_COMBO(TABR, TAB, 6 7)
        HOR_COMBO(BSPCR, BSPC, 16 17)
        HOR_COMBO(ENTERR, ENTER, 26 27)
        HOR_COMBO(DELR, DEL, 17 18)

        // both hands horizontal combos
        combo_CAPS_WORD {
            timeout-ms = <30>;
            key-positions = <32 33>;
            bindings = <&caps_word>;
        };
    };
};