## config/west.yml
```yaml
manifest:
  remotes:
    - name: zmkfirmware
      url-base: https://github.com/LOWPROKB
  projects:
    - name: zmk
      remote: zmkfirmware
      #revision: corne-ish-zen-v2
      revision: ef689f2bbdd1461477ac762f527d051bcead4253
      import: app/west.yml
  self:
    path: config
```
