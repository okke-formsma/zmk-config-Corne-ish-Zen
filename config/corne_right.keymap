/*
*
* Copyright (c) 2021 lowprokb.ca
* SPDX-License-Identifier: MIT
*
*/

#include "corne.keymap"

/*
// not sure about this, probably not necessary for corne?
&five_column_transform {
    col-offset = <6>;
};
*/